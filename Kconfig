## main/Kconfig.projbuild
```kconfig
menu "LCD Configuration"

    choice LCD_CONTROLLER
        prompt "LCD controller model"
        default LCD_CONTROLLER_SSD1306
        help
            Select LCD controller model

        config LCD_CONTROLLER_SSD1306
            bool "SSD1306"

        config LCD_CONTROLLER_SH1107
            bool "SH1107"
    endchoice

endmenu
```
